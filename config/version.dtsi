#define VERSION_MACRO
macro_ver: macro_ver {
compatible = "zmk,behavior-macro";
#binding-cells = <0>;
bindings = <&kp N2>, <&kp N0>, <&kp N2>, <&kp N5>, <&kp N0>, <&kp N5>, <&kp N0>, <&kp N5>, <&kp MINUS>, <&kp N2>, <&kp N0>, <&kp N2>, <&kp N5>, <&kp MINUS>, <&kp N0>, <&kp N2>, <&kp N8>, <&kp B>, <&kp N0>, <&kp N4>, <&kp D>, <&kp MINUS>, <&kp C>, <&kp L>, <&kp I>, <&kp Q>, <&kp U>, <&kp E>, <&kp RET>;
};
